## board/sensity/mx6qfalcon/Kconfig
```kconfig
if TARGET_MX6QFALCON

config SYS_BOARD
	default "mx6qfalcon"

config SYS_VENDOR
	default "sensity"

config SYS_SOC
	default "mx6"

config SYS_CONFIG_NAME
	default "mx6qfalcon"

config MANUFACTURING
	bool "Build for manufacturing use"

endif
```

## configs/mx6qfalcon2g_defconfig
```kconfig
CONFIG_ARM=y
CONFIG_ARCH_MX6=y
CONFIG_TARGET_MX6QFALCON=y
CONFIG_SYS_EXTRA_OPTIONS="IMX_CONFIG=board/sensity/mx6qfalcon/mx6qfalcon2g.cfg,MX6Q,DDR_MB=2048"
```

## configs/mx6qfalcon2g_test_defconfig
```kconfig
CONFIG_ARM=y
CONFIG_ARCH_MX6=y
CONFIG_TARGET_MX6QFALCON=y
CONFIG_SYS_EXTRA_OPTIONS="IMX_CONFIG=board/sensity/mx6qfalcon/mx6qfalcon2g.cfg,MX6Q,DDR_MB=2048"
CONFIG_BOOTDELAY=5
# CONFIG_CONSOLE_MUX is not set
CONFIG_SYS_CONSOLE_IS_IN_ENV=y
CONFIG_SYS_CONSOLE_OVERWRITE_ROUTINE=y
CONFIG_MANUFACTURING=y
CONFIG_DDRTEST=y
CONFIG_HUSH_PARSER=y
CONFIG_CMD_BOOTZ=y
# CONFIG_CMD_IMLS is not set
# CONFIG_CMD_FLASH is not set
CONFIG_CMD_MMC=y
CONFIG_CMD_I2C=y
CONFIG_CMD_GPIO=y
CONFIG_CMD_DHCP=y
CONFIG_CMD_MII=y
CONFIG_CMD_PING=y
CONFIG_CMD_CACHE=y
CONFIG_CMD_EXT2=y
CONFIG_CMD_EXT4=y
CONFIG_CMD_FAT=y
CONFIG_CMD_FS_GENERIC=y
CONFIG_DM=y
CONFIG_DM_THERMAL=y
CONFIG_OF_LIBFDT=y
```
